# RNG200 register map
File version: 1
BCM2711 RNG200 random generator
Registers are read-only, no defined reset value unless marked. A register's access mark holds for its fields unless they carry their own. Offsets are from the block's base; lines under a group give offsets from that group; [hi:lo] are bit positions; {n}, {i} and the like mark numbered series; 'fields as' and 'values as' point back to an identical list; <NAME> marks a mode.

## Memory map
0x00000000 RNG200 size 0x28

## RNG200
Base 0x00000000
0x00 CTRL rw — RNG_CTRL: control; both drivers set bit 0 to start the generator and clear it to stop it
  [0] RBG_EN — The random bit generator runs
0x20 FIFO_DATA read-modifies — RNG_FIFO_DATA: each read takes the next 32-bit random word from the FIFO; a read while FIFO_COUNT is zero is undocumented, and no driver makes one
  [31:0] WORD
0x24 FIFO_COUNT — RNG_FIFO_COUNT: the FIFO's fill
  [7:0] COUNT — The 32-bit words FIFO_DATA holds

## Notices in the file
Copyright (c) 2026, Stanislav Sedov <stas@deglitch.com>
SPDX-License-Identifier: BSD-2-Clause
