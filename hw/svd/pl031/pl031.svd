# PL031 register map
File version: 1
Arm PrimeCell Real Time Clock (PL031), its data register
Registers are read-only, no defined reset value unless marked. A register's access mark holds for its fields unless they carry their own. Offsets are from the block's base; lines under a group give offsets from that group; [hi:lo] are bit positions; {n}, {i} and the like mark numbered series; 'fields as' and 'values as' point back to an identical list; <NAME> marks a mode.

## Memory map
0x00000000 PL031 size 0x4

## PL031
Base 0x00000000
0x00 DR — RTCDR: the clock's current value
  [31:0] COUNT — The clock's count; QEMU virt counts seconds since 1970 (unverified against a source)

## Notices in the file
Copyright (c) 2026, Stanislav Sedov <stas@deglitch.com>
SPDX-License-Identifier: BSD-2-Clause
