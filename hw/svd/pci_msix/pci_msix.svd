# pci_msix register map
File version: 1
PCIe MSI-X table
Registers are read-write, no defined reset value unless marked. A register's access mark holds for its fields unless they carry their own. Offsets are from the block's base; lines under a group give offsets from that group; [hi:lo] are bit positions; {n}, {i} and the like mark numbered series; 'fields as' and 'values as' point back to an identical list; <NAME> marks a mode.

## Memory map
0x00000000 pci_msix size 0x8000 — The MSI-X table entries of one function

## pci_msix — The MSI-X table entries of one function
Base 0x00000000
{0x0+0x10*i} ADDRESS_LO[{i}] (i=0..2047)
  [31:0] ADDRESS
{0x4+0x10*i} ADDRESS_HI[{i}] (i=0..2047)
  [31:0] ADDRESS
{0x8+0x10*i} DATA[{i}] (i=0..2047)
  [31:0] DATA
{0xC+0x10*i} VECTOR_CONTROL[{i}] (i=0..2047)
  [0] MASK

## Notices in the file
Copyright (c) 2026, Stanislav Sedov <stas@deglitch.com>
SPDX-License-Identifier: BSD-2-Clause
